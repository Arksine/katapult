## src/gd32/Kconfig
```kconfig
# Kconfig settings for GigaDevice GD32 processors

if MACH_GD32

config GD32_SELECT
    bool
    default y

config BOARD_DIRECTORY
    string
    default "gd32"

choice
    prompt "Processor model"
    config MACH_GD32F303XB
        bool "GD32F303xB"
        select MACH_GD32F303XX
        select MACH_GD32F30X
    config MACH_GD32F303XC
        bool "GD32F303xC"
        select MACH_GD32F303XX
        select MACH_GD32F30X
    config MACH_GD32F303XE
        bool "GD32F303xE"
        select MACH_GD32F303XX
        select MACH_GD32F30X
    config MACH_GD32E230X6
        bool "GD32E230x6"
        select MACH_GD32E23X
    config MACH_GD32E230X8
        bool "GD32E230x8"
        select MACH_GD32E23X
endchoice

config MACH_GD32F303XX
    bool
config MACH_GD32F30X
    bool
config MACH_GD32E23X
    bool

config MCU
    string
    default "gd32f303xb" if MACH_GD32F303XB
    default "gd32f303xc" if MACH_GD32F303XC
    default "gd32f303xe" if MACH_GD32F303XE
    default "gd32e230x6" if MACH_GD32E230X6
    default "gd32e230x8" if MACH_GD32E230X8

config CLOCK_FREQ
    int
    default 120000000 if MACH_GD32F30X
    default 72000000 if MACH_GD32E23X

config FLASH_SIZE
    hex
    default 0x20000 if MACH_GD32F303XB
    default 0x40000 if MACH_GD32F303XC
    default 0x80000 if MACH_GD32F303XE
    default 0x8000 if MACH_GD32E230X6
    default 0x10000 if MACH_GD32E230X8
config FLASH_BOOT_ADDRESS
    hex
    default 0x08000000
config RAM_START
    hex
    default 0x20000000
config RAM_SIZE
    hex
    default 0x8000 if MACH_GD32F303XB
    default 0xc000 if MACH_GD32F303XC
    default 0x10000 if MACH_GD32F303XE
    default 0x1800 if MACH_GD32E230X6
    default 0x2000 if MACH_GD32E230X8
config STACK_SIZE
    int
    default 512

choice
    prompt "Build Katapult deployment application"
    config GD32_FLASH_START_0000
        bool "Do not build"
    config GD32_FLASH_START_2000
        bool "8KiB bootloader"
endchoice
config FLASH_APPLICATION_ADDRESS
    hex
    default 0x08002000 if GD32_FLASH_START_2000
    default 0x08000000

choice
    prompt "Communication interface"
    default GD32_SERIAL_USART1_PA2_PA3 if MACH_GD32F30X
    default GD32E230_SERIAL_USART1_PA2_PA3 if MACH_GD32E23X
    config GD32_SERIAL_USART1_PA2_PA3
        bool "Serial (USART1 PA3/PA2)"
        depends on MACH_GD32F30X
        select SERIAL
    config GD32_USB_PA11_PA12
        bool "USB FS (PA11/PA12)"
        depends on MACH_GD32F30X
        select USBSERIAL
    config GD32_CANBUS_PA11_PA12
        bool "CAN0 (PA11/PA12)"
        depends on MACH_GD32F30X
        select CANSERIAL
    config GD32_CANBUS_PB8_PB9
        bool "CAN0 (PB8/PB9 remap)"
        depends on MACH_GD32F30X
        select CANSERIAL
    config GD32_CANBUS_PD0_PD1
        bool "CAN0 (PD0/PD1 remap)"
        depends on MACH_GD32F30X
        select CANSERIAL
    config GD32E230_SERIAL_USART1_PA2_PA3
        bool "Serial (USART1 PA3/PA2)"
        depends on MACH_GD32E23X
        select SERIAL
    config GD32E230_SERIAL_USART0_PA9_PA10
        bool "Serial (USART0 PA10/PA9)"
        depends on MACH_GD32E23X
        select SERIAL
endchoice

config HAVE_CHIPID
    bool
    default y if MACH_GD32F30X

config FLASH_START
    hex
    default 0x08000000

choice
    prompt "Application start offset"
    config GD32_APP_START_2000
        bool "8KiB offset"
endchoice
config LAUNCH_APP_ADDRESS
    hex
    default 0x08002000 if GD32_APP_START_2000
    default 0x08002000
config BLOCK_SIZE
    int
    default 64

endif
```
