## src/Kconfig
```kconfig
# Main Kconfig settings

VERSION := $(shell, git describe --tags --long --always --dirty 2> /dev/null)

mainmenu "Katapult Configuration $(VERSION)"

config LOW_LEVEL_OPTIONS
    bool
    default y

choice
    prompt "Micro-controller Architecture"
    config MACH_LPC176X
        bool "LPC176x (Smoothieboard)"
    config MACH_STM32
        bool "STMicroelectronics STM32"
    config MACH_RP2040
        bool "Raspberry Pi RP2040"
endchoice

source "src/lpc176x/Kconfig"
source "src/stm32/Kconfig"
source "src/rp2040/Kconfig"

# Generic configuration options for serial ports
config SERIAL
    bool
config SERIAL_BOOTLOADER_SIDECHANNEL
    bool
config SERIAL_BAUD
    depends on SERIAL
    int "Baud rate for serial port" if LOW_LEVEL_OPTIONS
    default 250000
    help
        Specify the baud rate of the serial port. This should be set
        to 250000. Read the FAQ before changing this value.

# Generic configuration options for USB
config USBSERIAL
    bool
config USBCANBUS
    bool
config USB
    bool
    default y if USBSERIAL || USBCANBUS
config USB_VENDOR_ID
    default 0x1d50
config USB_DEVICE_ID
    default 0x6177
config USB_SERIAL_NUMBER_CHIPID
    depends on USB && HAVE_CHIPID
    default y
config USB_SERIAL_NUMBER
    default "12345"

menu "USB ids"
    depends on USB && LOW_LEVEL_OPTIONS
config USB_VENDOR_ID
    hex "USB vendor ID" if USBSERIAL
config USB_DEVICE_ID
    hex "USB device ID" if USBSERIAL
config USB_SERIAL_NUMBER_CHIPID
    bool "USB serial number from CHIPID" if HAVE_CHIPID
config USB_SERIAL_NUMBER
    string "USB serial number" if !USB_SERIAL_NUMBER_CHIPID
endmenu

# Generic configuration options for CANbus
config CANSERIAL
    bool
config CANBUS
    bool
    default y if CANSERIAL || USBCANBUS
config CANBUS_FREQUENCY
    int "CAN bus speed" if LOW_LEVEL_OPTIONS && CANBUS
    default 500000
config CANBUS_FILTER
    bool
    default y if CANSERIAL

# Support setting gpio state at startup
config INITIAL_PINS
    string "GPIO pins to set on bootloader entry"
    depends on LOW_LEVEL_OPTIONS
    help
        One may specify a comma separated list of gpio pins to set
        during bootloader entry (these gpio pins are not set if the
        main application is started nor are they set while checking
        for a bootloader request). By default the pins will be set to
        output high - preface a pin with a '!' character to set that
        pin to output low.

config ENABLE_DOUBLE_RESET
    bool "Support bootloader entry on rapid double click of reset button"
    default y

config ENABLE_BUTTON
    bool "Enable bootloader entry on button (or gpio) state"
    default n

config BUTTON_PIN
    string "Button GPIO Pin"
    depends on ENABLE_BUTTON

config ENABLE_LED
    bool "Enable Status LED"
    default n

config STATUS_LED_PIN
    string "Status LED GPIO Pin"
    depends on ENABLE_LED

config BUILD_DEPLOYER
    bool
    default y if FLASH_APPLICATION_ADDRESS != FLASH_BOOT_ADDRESS
    default n

# The HAVE_x options allow boards to disable support for some commands
# if the hardware does not support the feature.
config HAVE_CHIPID
    bool
    default n
```

## src/lpc176x/Kconfig
```kconfig
# Kconfig settings for LPC176x processors

if MACH_LPC176X

config LPC_SELECT
    bool
    default y
    select HAVE_GPIO
    select HAVE_GPIO_ADC
    select HAVE_GPIO_I2C
    select HAVE_GPIO_SPI
    select HAVE_GPIO_BITBANGING
    select HAVE_STRICT_TIMING
    select HAVE_CHIPID
    select HAVE_GPIO_HARD_PWM
    select HAVE_STEPPER_BOTH_EDGE

config BOARD_DIRECTORY
    string
    default "lpc176x"

choice
    prompt "Processor model"
    config MACH_LPC1768
        bool "lpc1768 (100 MHz)"
    config MACH_LPC1769
        bool "lpc1769 (120 MHz)"
endchoice

config MCU
    string
    default "lpc1768" if MACH_LPC1768
    default "lpc1769" if MACH_LPC1769

config CLOCK_FREQ
    int
    default 100000000 if MACH_LPC1768
    default 120000000 if MACH_LPC1769

config FLASH_SIZE
    hex
    default 0x80000

config FLASH_BOOT_ADDRESS
    hex
    default 0x0

config RAM_START
    hex
    default 0x10000000

config RAM_SIZE
    hex
    default 0x7ee0 # (0x8000 - 256 - 32) 32 bytes for ISP commands, 256 bytes for ISP stack

config STACK_SIZE
    int
    default 512


######################################################################
# Bootloader
######################################################################

choice
    prompt "Build CanBoot deployment application"
    config LPC_FLASH_START_0000
        bool "Do not build"
    config LPC_FLASH_START_4000
        bool "16KiB bootloader (Smoothieware bootloader)"
endchoice
config FLASH_APPLICATION_ADDRESS
    hex
    default 0x4000 if LPC_FLASH_START_4000
    default 0x0000


######################################################################
# Communication inteface
######################################################################

choice
    prompt "Communication interface"
    config LPC_USB
        bool "USB"
        select USBSERIAL
    config LPC_SERIAL_UART0_P03_P02
        bool "Serial (on UART0 P0.3/P0.2)"
        select SERIAL
    config LPC_SERIAL_UART3_P429_P428
        bool "Serial (on UART3 P4.29/P4.28)" if LOW_LEVEL_OPTIONS
        select SERIAL
endchoice


######################################################################
# Flash settings
######################################################################

config FLASH_START
    hex
    default 0x0000

config LAUNCH_APP_ADDRESS
    hex
    default 0x4000

config BLOCK_SIZE
    int
    default 64

endif
```

## src/rp2040/Kconfig
```kconfig
# Kconfig settings for RPxxxx processors

if MACH_RPXXXX

config RPXXXX_SELECT
    bool
    default y
    select HAVE_GPIO
    select HAVE_CHIPID
    select HAVE_BOARD_CHECK_DOUBLE_RESET if MACH_RP2350

config BOARD_DIRECTORY
    string
    default "rp2040"

######################################################################
# Chip selection
######################################################################

choice
    prompt "Processor model"
    config MACH_RP2040
        bool "rp2040"
    config MACH_RP2350
        bool "rp2350"
endchoice

config MCU
    string
    default "rp2040" if MACH_RP2040
    default "rp2350" if MACH_RP2350

config CLOCK_FREQ
    int
    default 12000000 if MACH_RP2040
    default 150000000 if MACH_RP2350

config FLASH_SIZE
    hex
    default 0x200000

config FLASH_BOOT_ADDRESS
    hex
    default 0x10000100 if MACH_RP2040 # Stage2 binary starts at 0x10000000
    default 0x10000000 if MACH_RP2350

config RAM_START
    hex
    default 0x20000000

config RAM_SIZE
    hex
    default 0x42000 if MACH_RP2040
    default 0x82000 if MACH_RP2350

config STACK_SIZE
    int
    default 512

######################################################################
# SD Card Configuration
######################################################################

menu "SD Card Configuration"

choice
    default RPXXXX_SD_DISABLED
    prompt "SD Card Interface"
    config RPXXXX_SD_DISABLED
        bool "SD Card Disabled"
    config RPXXXX_SD_SPI0_GPIO_0_3_2
        bool "spi0 (on gpio0,gpio3,gpio2)"
        select SDCARD_SPI
    config RPXXXX_SD_SPI0_GPIO_4_7_6
        bool "spi0 (on gpio4,gpio7,gpio6)"
        select SDCARD_SPI
    config RPXXXX_SD_SPI0_GPIO_16_19_18
        bool "spi0 (on gpio16,gpio19,gpio18)"
        select SDCARD_SPI
    config RPXXXX_SD_SPI0_GPIO_20_23_22
        bool "spi0 (on gpio20,gpio23,gpio22)"
        select SDCARD_SPI
    config RPXXXX_SD_SPI0_GPIO_4_3_2
        bool "spi0 (on gpio4,gpio3,gpio2)"
        select SDCARD_SPI
    config RPXXXX_SD_SPI1_GPIO_8_11_10
        bool "spi1 (on gpio8,gpio11,gpio10)"
        select SDCARD_SPI
    config RPXXXX_SD_SPI1_GPIO_12_15_14
        bool "spi1 (on gpio12,gpio15,gpio14)"
        select SDCARD_SPI
    config RPXXXX_SD_SPI1_GPIO_24_27_26
        bool "spi1 (on gpio24,gpio27,gpio26)"
        select SDCARD_SPI
    config RPXXXX_SOFTWARE_SPI
        bool "Software SPI"
        select SDCARD_SOFTWARE_SPI
endchoice

config SOFTWARE_SPI_PINS
    depends on SDCARD_SOFTWARE_SPI
    string "SD Card Software SPI Pins (MISO,MOSI,SCLK)"
config SD_SPI_CS_PIN
    depends on SDCARD_SPI || SDCARD_SOFTWARE_SPI
    string "SD Card SPI CS Pin"
config SD_FIRMWARE_NAME
    depends on !RPXXXX_SD_DISABLED
    string "Firmware file name"
    default "firmware.bin"
config FATFS_ENABLE_LFN
    depends on !RPXXX_SD_DISABLED
    bool "Enable Long File Name Support"

endmenu

config SD_SPI_BUS_NAME
    string
    default "spi0_gpio0_gpio3_gpio2" if RPXXXX_SD_SPI0_GPIO_0_3_2
    default "spi0_gpio4_gpio7_gpio6" if RPXXXX_SD_SPI0_GPIO_4_7_6
    default "spi0_gpio16_gpio19_gpio18" if RPXXXX_SD_SPI0_GPIO_16_19_18
    default "spi0_gpio20_gpio23_gpio22" if RPXXXX_SD_SPI0_GPIO_20_23_22
    default "spi0_gpio4_gpio3_gpio2" if RPXXXX_SD_SPI0_GPIO_4_3_2
    default "spi1_gpio8_gpio11_gpio10" if RPXXXX_SD_SPI1_GPIO_8_11_10
    default "spi1_gpio12_gpio15_gpio14" if RPXXXX_SD_SPI1_GPIO_12_15_14
    default "spi1_gpio24_gpio27_gpio26" if RPXXXX_SD_SPI1_GPIO_24_27_26
    default "disabled"

######################################################################
# Bootloader options
######################################################################

config RP2040_HAVE_STAGE2
    bool
    default y if MACH_RP2040

choice
    prompt "Flash chip" if LOW_LEVEL_OPTIONS && RP2040_HAVE_STAGE2
    config RP2040_FLASH_W25Q080
        bool "W25Q080 with CLKDIV 2"
    config RP2040_FLASH_GENERIC_03
        bool "GENERIC_03H with CLKDIV 4"
endchoice

config RP2040_STAGE2_FILE
    string
    default "boot2_generic_03h.S" if RP2040_FLASH_GENERIC_03
    default "boot2_w25q080.S"

config RP2040_STAGE2_CLKDIV
    int
    default 4 if RP2040_FLASH_GENERIC_03
    default 2

######################################################################
# Deployer
######################################################################

choice
    prompt "Build Katapult deployment application"
    config RPXXXX_FLASH_START_0000
        bool "Do not build"
        depends on MACH_RP2350
    config RPXXXX_FLASH_START_0100
        bool "Do not build"
        depends on MACH_RP2040
    config RPXXXX_FLASH_START_4000
        bool "16KiB bootloader"
    config RPXXXX_FLASH_START_8000
        bool "32KiB bootloader"
endchoice
config FLASH_APPLICATION_ADDRESS
    hex
    default 0x10004000 if RPXXXX_FLASH_START_4000
    default 0x10008000 if RPXXXX_FLASH_START_8000
    default 0x10000100 if RPXXXX_FLASH_START_0100
    default 0x10000000 if RPXXXX_FLASH_START_0000

######################################################################
# Communication inteface
######################################################################

choice
    prompt "Communication Interface"
    config RPXXXX_USB
        bool "USBSERIAL"
        select USBSERIAL
    config RPXXXX_SERIAL_UART0_PINS_0_1
        bool "UART0 on GPIO0/GPIO1"
        select SERIAL
    config RPXXXX_SERIAL_UART0_PINS_12_13
        bool "UART0 on GPIO12/GPIO13" if LOW_LEVEL_OPTIONS
        select SERIAL
    config RPXXXX_SERIAL_UART0_PINS_16_17
        bool "UART0 on GPIO16/GPIO17" if LOW_LEVEL_OPTIONS
        select SERIAL
    config RPXXXX_SERIAL_UART0_PINS_28_29
        bool "UART0 on GPIO28/GPIO29" if LOW_LEVEL_OPTIONS
        select SERIAL
    config RPXXXX_SERIAL_UART1_PINS_4_5
        bool "UART1 on GPIO4/GPIO5" if LOW_LEVEL_OPTIONS
        select SERIAL
    config RPXXXX_SERIAL_UART1_PINS_8_9
        bool "UART1 on  GPIO8/GPIO9" if LOW_LEVEL_OPTIONS
        select SERIAL
    config RPXXXX_SERIAL_UART1_PINS_20_21
        bool "UART1 on  GPIO20/GPIO21" if LOW_LEVEL_OPTIONS
        select SERIAL
    config RPXXXX_SERIAL_UART1_PINS_24_25
        bool "UART1 on GPIO24/GPIO25"  if LOW_LEVEL_OPTIONS
        select SERIAL
    config RPXXXX_CANBUS
        bool "CAN bus"
        select CANSERIAL
    config RPXXXX_USBCANBUS
        bool "USB to CAN bus bridge"
        select USBCANBUS
endchoice

config RPXXXX_CANBUS_GPIO_RX
    int "CAN RX gpio number" if CANBUS
    default 4
    range 0 29

config RPXXXX_CANBUS_GPIO_TX
    int "CAN TX gpio number" if CANBUS
    default 5
    range 0 29

######################################################################
# Flash settings
######################################################################

config FLASH_START
    hex
    default 0x10000000

choice
    prompt "Application start offset"
    config RPXXXX_APP_START_4000
        bool "16KiB offset"
    config RPXXXX_APP_START_8000
        bool "32KiB offset"
endchoice

config LAUNCH_APP_ADDRESS
    default 0x10004000 if RPXXXX_APP_START_4000
    default 0x10008000 if RPXXXX_APP_START_8000
    default 0x10004000
    hex

config BLOCK_SIZE
    int
    default 64

endif
```
